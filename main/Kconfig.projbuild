## main/Kconfig.projbuild
```kconfig
menu "Example Configuration"

    config STORE_HISTORY
        bool "Store command history in flash"
        default y
        help
            Linenoise line editing library provides functions to save and load
            command history. If this option is enabled, initalizes a FAT filesystem
            and uses it to store command history.

endmenu

menu "WiFi Repeater"

    config REPEATER_MODE
        bool "Enable L2 WiFi AP-STA repeater mode"
        default n
        help
            When enabled, the ESP32 acts as a true L2 bridge between the
            upstream WiFi STA and the downstream WiFi AP: no NAPT, no
            AP-side DHCP server. AP clients receive DHCP leases from the
            upstream server via Option 61 proxying and live on the
            upstream subnet. The ESP32 itself takes a single IP on that
            subnet via its STA; all local services (web UI, console,
            OTA) bind to that IP.

            When disabled, the firmware behaves as a traditional NAT
            router (NAPT + AP-side DHCPS).

endmenu

menu "MQTT Home Assistant"

    config MQTT_HOMEASSISTANT
        bool "Enable MQTT Home Assistant integration"
        default y
        help
            Publishes router telemetry to an MQTT broker with
            Home Assistant auto-discovery. Adds ~58 KB flash.
            RAM is only used when a broker is configured and enabled.

    config MQTT_HA_BUFFER_SIZE
        int "MQTT buffer size (bytes)"
        default 1024
        depends on MQTT_HOMEASSISTANT

    config MQTT_DEFAULT_INTERVAL
        int "Default publish interval (seconds)"
        default 30
        depends on MQTT_HOMEASSISTANT
        range 5 3600

endmenu
```

## sdkconfig.defaults.esp32c3
```kconfig
# ESP32-C3 target overrides

# Max CPU frequency on C3 is 160 MHz
CONFIG_ESP_DEFAULT_CPU_FREQ_MHZ_160=y

# Use built-in USB_SERIAL_JTAG for console output
CONFIG_ESP_CONSOLE_UART_DEFAULT=n
CONFIG_ESP_CONSOLE_USB_SERIAL_JTAG=y
```

## sdkconfig.defaults.esp32c6
```kconfig
# ESP32-C6 target overrides

# Max CPU frequency on C6 is 160 MHz
CONFIG_ESP_DEFAULT_CPU_FREQ_MHZ_160=y

# Use built-in USB_SERIAL_JTAG for console output
CONFIG_ESP_CONSOLE_UART_DEFAULT=n
CONFIG_ESP_CONSOLE_USB_SERIAL_JTAG=y

# Disable IEEE 802.15.4 (Zigbee/Thread) — not used, but enabled by default on C6
CONFIG_IEEE802154_ENABLED=n

# Reduce static log level to save flash space
CONFIG_LOG_DEFAULT_LEVEL_WARN=y
CONFIG_LOG_DEFAULT_LEVEL=2
```

## sdkconfig.defaults.esp32h2
```kconfig
# ESP32-H2 target overrides

# Max CPU frequency on H2 is 96 MHz
CONFIG_ESP_DEFAULT_CPU_FREQ_MHZ_96=y

# Use built-in USB_SERIAL_JTAG for console output
CONFIG_ESP_CONSOLE_UART_DEFAULT=n
CONFIG_ESP_CONSOLE_USB_SERIAL_JTAG=y
```

## sdkconfig.defaults.esp32s3
```kconfig
# ESP32-S3 target overrides

# Use built-in USB_SERIAL_JTAG for console output
CONFIG_ESP_CONSOLE_UART_DEFAULT=n
CONFIG_ESP_CONSOLE_USB_SERIAL_JTAG=y
```
